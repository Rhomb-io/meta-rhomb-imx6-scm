## conf/layer.conf
```bitbake
# We have a conf and classes directory, add to BBPATH
BBPATH .= ":${LAYERDIR}"

# We have recipes-* directories, add to BBFILES
BBFILES += "${LAYERDIR}/recipes-*/*/*.bb \
	${LAYERDIR}/recipes-*/*/*.bbappend"

BBFILE_COLLECTIONS += "rhomb-scm"
BBFILE_PATTERN_rhomb-scm = "^${LAYERDIR}/"
BBFILE_PRIORITY_rhomb-scm = "6"
```
